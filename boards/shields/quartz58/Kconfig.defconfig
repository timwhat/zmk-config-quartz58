## boards/shields/quartz58/Kconfig.defconfig
```kconfig
if SHIELD_QUARTZ58_LEFT

config ZMK_KEYBOARD_NAME
    default "quartz58"

config ZMK_SPLIT_ROLE_CENTRAL
    default y

config ZMK_DISPLAY
    default y
    
config ZMK_DISPLAY_STATUS_SCREEN_CUSTOM
    default y

#config ZMK_POINTING
#    default y

endif

if SHIELD_QUARTZ58_LEFT || SHIELD_QUARTZ58_RIGHT

config ZMK_SPLIT
    default y

if ZMK_DISPLAY

config I2C
    default y

config SSD1306
    default y

endif # ZMK_DISPLAY

if LVGL

config LV_Z_VDB_SIZE
    default 64

config LV_DPI_DEF
    default 148

config LV_Z_BITS_PER_PIXEL
    default 1

choice LV_COLOR_DEPTH
    default LV_COLOR_DEPTH_1
endchoice

endif # LVGL

endif
```

## boards/shields/quartz58/Kconfig.shield
```kconfig
config ZMK_STUDIO
    bool "Enable ZMK Studio support"
    default y

config SHIELD_QUARTZ58_LEFT
    def_bool $(shields_list_contains, quartz58_left)

config SHIELD_QUARTZ58_RIGHT
    def_bool $(shields_list_contains, quartz58_right)
```

## config/west.yml
```yaml
manifest:
  defaults:
    revision: v0.3
  remotes:
    - name: zmkfirmware
      url-base: https://github.com/zmkfirmware
    - name: aym1607
      url-base: https://github.com/AYM1607
    - name: mctechnology17
      url-base: https://github.com/mctechnology17
    # Additional modules containing boards/shields/custom code can be listed here as well
    # See https://docs.zephyrproject.org/3.2.0/develop/west/manifest.html#projects
  projects:
    - name: zmk
      remote: zmkfirmware
      import: app/west.yml
    # support nice_oled and nice_epaper
    - name: zmk-nice-oled
      remote: mctechnology17
      revision: main
    - name: zmk-driver-azoteq-iqs5xx
      remote: aym1607
      revision: main
  self:
    path: config
```

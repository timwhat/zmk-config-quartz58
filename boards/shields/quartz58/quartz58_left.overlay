/*
 * Copyright (c) 2020 Pete Johanson
 *
 * SPDX-License-Identifier: MIT
 */

#include <dt-bindings/zmk/matrix_transform.h>
#include "quartz58.dtsi"
/ {
    kscan0: kscan {
        compatible = "zmk,kscan-gpio-matrix";
        label = "KSCAN";
        diode-direction = "col2row";

        row-gpios
            = <&gpio1 15 (GPIO_ACTIVE_HIGH | GPIO_PULL_DOWN)>
            , <&gpio1 13 (GPIO_ACTIVE_HIGH | GPIO_PULL_DOWN)>
            , <&gpio1 11 (GPIO_ACTIVE_HIGH | GPIO_PULL_DOWN)>
            , <&gpio0 10 (GPIO_ACTIVE_HIGH | GPIO_PULL_DOWN)>
            , <&gpio0 9  (GPIO_ACTIVE_HIGH | GPIO_PULL_DOWN)>
        ;

        col-gpios
            = <&gpio0 22 GPIO_ACTIVE_HIGH>
            , <&gpio0 24 GPIO_ACTIVE_HIGH>
            , <&gpio1 0  GPIO_ACTIVE_HIGH>
            , <&gpio0 11 GPIO_ACTIVE_HIGH>
            , <&gpio1 4  GPIO_ACTIVE_HIGH>
            , <&gpio1 6  GPIO_ACTIVE_HIGH>
            , <&gpio0 2  GPIO_ACTIVE_HIGH>
        ;
    };

    left_encoder: encoder_left {
        compatible = "alps,ec11";
        a-gpios = <&gpio0 26 (GPIO_ACTIVE_HIGH | GPIO_PULL_UP)>;
        b-gpios = <&gpio0 6 (GPIO_ACTIVE_HIGH | GPIO_PULL_UP)>;
        steps = <80>;
    };

    sensors: sensors {
        compatible = "zmk,keymap-sensors";
        sensors = <&left_encoder>;
        triggers-per-rotation = <20>;
    };
//  physical_layout0: physical_layout_0 {
//         compatible = "zmk,physical-layout";
//         display-name = "quartz58_left";
//         transform = <&default_transform>;
//         kscan = <&kscan0>;
//         keys
//             = <&key_physical_attrs 100 100    0    0       0     0     0>
//             , <&key_physical_attrs 100 100  100    0       0     0     0>
//             , <&key_physical_attrs 100 100  200    0       0     0     0>
//             , <&key_physical_attrs 100 100  300    0       0     0     0>
//             , <&key_physical_attrs 100 100  400    0       0     0     0>
//             , <&key_physical_attrs 100 100  500    0       0     0     0>
//             , <&key_physical_attrs 100 100    0  100       0     0     0>
//             , <&key_physical_attrs 100 100  100  100       0     0     0>
//             , <&key_physical_attrs 100 100  200  100       0     0     0>
//             , <&key_physical_attrs 100 100  300  100       0     0     0>
//             , <&key_physical_attrs 100 100  400  100       0     0     0>
//             , <&key_physical_attrs 100 100  500  100       0     0     0>
//             , <&key_physical_attrs 100 100  700  100       0     0     0>
//             , <&key_physical_attrs 100 100    0  200       0     0     0>
//             , <&key_physical_attrs 100 100  100  200       0     0     0>
//             , <&key_physical_attrs 100 100  200  200       0     0     0>
//             , <&key_physical_attrs 100 100  300  200       0     0     0>
//             , <&key_physical_attrs 100 100  400  200       0     0     0>
//             , <&key_physical_attrs 100 100  500  200       0     0     0>
//             , <&key_physical_attrs 100 100  600  200       0     0     0>
//             , <&key_physical_attrs 100 100  700  200       0     0     0>
//             , <&key_physical_attrs 100 100  800  200       0     0     0>
//             , <&key_physical_attrs 100 100    0  300       0     0     0>
//             , <&key_physical_attrs 100 100  100  300       0     0     0>
//             , <&key_physical_attrs 100 100  200  300       0     0     0>
//             , <&key_physical_attrs 100 100  300  300       0     0     0>
//             , <&key_physical_attrs 100 100  400  300       0     0     0>
//             , <&key_physical_attrs 100 100  500  300       0     0     0>
//             , <&key_physical_attrs 100 100  600  300       0     0     0>
//             , <&key_physical_attrs 100 100  700  300       0     0     0>
//             , <&key_physical_attrs 100 100  200  400       0     0     0>
//             , <&key_physical_attrs 100 100  300  400       0     0     0>
//             , <&key_physical_attrs 100 100  400  400       0     0     0>
//             , <&key_physical_attrs 100 100  500  400       0     0     0>
//             ;
};